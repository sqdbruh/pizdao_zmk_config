## config/boards/arm/dao/Kconfig
```kconfig
# Copyright (c) 2021 Rafael Yumagulov
# SPDX-License-Identifier: MIT

config BOARD_ENABLE_DCDC
	bool "Enable DCDC mode"
	select SOC_DCDC_NRF52X
	default y
	depends on (BOARD_DAO_LEFT || BOARD_DAO_RIGHT)

config CONFIG_BOARD_ENABLE_DCDC_HV
	bool "Enable High Voltage DCDC converter"
	select SOC_DCDC_NRF52X
	default y
	depends on (BOARD_DAO_LEFT || BOARD_DAO_RIGHT)
```
